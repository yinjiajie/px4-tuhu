## src/modules/parachute_rs485/Kconfig
```kconfig
menuconfig MODULES_PARACHUTE_RS485
	bool "parachute_rs485"
	default n
	---help---
		Enable the RS485 parachute interface module.
```

## src/systemcmds/rk3588_uart_test/Kconfig
```kconfig
menuconfig SYSTEMCMDS_RK3588_UART_TEST
	bool "rk3588_uart_test"
	default n
	depends on PLATFORM_NUTTX
	---help---
		Enable a simple UART receive test tool for RK3588 to flight controller
		communication on ttyS2 or another selected serial port.

menuconfig USER_RK3588_UART_TEST
	bool "rk3588_uart_test running as userspace module"
	default y
	depends on BOARD_PROTECTED && SYSTEMCMDS_RK3588_UART_TEST
	---help---
		Put rk3588_uart_test in userspace memory
```
